## arch/arm/configs/selinux_defconfig
```kconfig
CONFIG_EXT2_FS_XATTR=n
CONFIG_EXT2_FS_SECURITY=n
CONFIG_EXT4_FS_XATTR=n
CONFIG_EXT4_FS_SECURITY=n
CONFIG_AUDIT=y
CONFIG_AUDITSYSCALL=y
CONFIG_SECURITY=n
CONFIG_LSM_MMAP_MIN_ADDR=4096
CONFIG_SECURITY_NETWORK=n
CONFIG_SECURITY_SELINUX=n
CONFIG_SECURITY_SELINUX_DEVELOP=y
CONFIG_SECURITY_SELINUX_AVC_STATS=y
CONFIG_SECURITY_SELINUX_CHECKREQPROT_VALUE=y
CONFIG_NETWORK_SECMARK=n
CONFIG_NF_CONNTRACK_SECMARK=n
CONFIG_NETFILTER_XT_TARGET_CONNSECMARK=n
CONFIG_NETFILTER_ADVANCED=n
CONFIG_NETFILTER_XT_TARGET_SECMARK=n
CONFIG_IP_NF_SECURITY=n
CONFIG_DEFAULT_SECURITY=n
CONFIG_DEFAULT_SECURITY="selinux"
CONFIG_DEFAULT_SECURITY_SELINUX=n
CONFIG_FAT_VIRTUAL_XATTR=y
CONFIG_FAT_VIRTUAL_XATTR_SELINUX_LABEL="u:object_r:sdcard_external:s0"
CONFIG_EXFAT_VIRTUAL_XATTR=y
CONFIG_ECRYPT_FS_VIRTUAL_FAT_XATTR=y
CONFIG_SDCARD_FS_XATTR=y
CONFIG_SEC_SELINUX=n
```
